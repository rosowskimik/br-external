## configs/zero2w_64_efi_defconfig
```kconfig
BR2_aarch64=y
BR2_PACKAGE_HOST_LINUX_HEADERS_CUSTOM_6_16=y
BR2_PACKAGE_GLIBC_UTILS=y
BR2_BINUTILS_VERSION_2_44_X=y
BR2_TOOLCHAIN_BUILDROOT_CXX=y
BR2_CCACHE=y
BR2_CCACHE_DIR="$(BR2_EXTERNAL_RPI_PATH)/ccache"
BR2_OPTIMIZE_S=y
BR2_GLOBAL_PATCH_DIR="$(BR2_EXTERNAL_RPI_PATH)/patches"
BR2_REPRODUCIBLE=y
BR2_PER_PACKAGE_DIRECTORIES=y
BR2_TARGET_GENERIC_HOSTNAME="zero2w"
BR2_TARGET_GENERIC_PASSWD_SHA512=y
BR2_INIT_SYSTEMD=y
# BR2_INIT_SYSTEMD_POPULATE_TMPFILES is not set
# BR2_TARGET_ENABLE_ROOT_LOGIN is not set
BR2_SYSTEM_BIN_SH_BASH=y
BR2_SYSTEM_DHCP="enu1u4"
BR2_SYSTEM_DEFAULT_PATH="/bin:/sbin:/usr/bin:/usr/sbin"
BR2_GENERATE_LOCALE="en_US"
BR2_TARGET_TZ_ZONELIST="europe"
BR2_TARGET_LOCALTIME="Europe/Warsaw"
BR2_ROOTFS_USERS_TABLES="$(BR2_EXTERNAL_RPI_PATH)/board/raspberrypi/common/users.txt"
BR2_ROOTFS_OVERLAY="$(BR2_EXTERNAL_RPI_PATH)/board/raspberrypi/common/overlay $(BR2_EXTERNAL_RPI_PATH)/board/raspberrypi/zero2w_64/overlay"
BR2_ROOTFS_POST_BUILD_SCRIPT="$(BR2_EXTERNAL_RPI_PATH)/board/raspberrypi/common/post-build.sh"
BR2_ROOTFS_POST_IMAGE_SCRIPT="$(BR2_EXTERNAL_RPI_PATH)/board/raspberrypi/zero2w_64/post-image.sh"
BR2_ROOTFS_POST_IMAGE_SCRIPT_ARGS="$(LINUX_IMAGE_NAME)"
BR2_LINUX_KERNEL=y
BR2_LINUX_KERNEL_CUSTOM_TARBALL=y
BR2_LINUX_KERNEL_CUSTOM_TARBALL_LOCATION="$(call github,raspberrypi,linux,a010b6488a04b98c594c06d81007296596382e16)/linux-a010b6488a04b98c594c06d81007296596382e16.tar.gz"
BR2_LINUX_KERNEL_USE_CUSTOM_CONFIG=y
BR2_LINUX_KERNEL_CUSTOM_CONFIG_FILE="$(BR2_EXTERNAL_RPI_PATH)/board/raspberrypi/zero2w_64/linux_defconfig"
BR2_LINUX_KERNEL_IMAGE_TARGET_CUSTOM=y
BR2_LINUX_KERNEL_ZSTD=y
BR2_LINUX_KERNEL_IMAGE_TARGET_NAME="vmlinuz.efi"
BR2_LINUX_KERNEL_DTS_SUPPORT=y
BR2_LINUX_KERNEL_INTREE_DTS_NAME="broadcom/bcm2710-rpi-zero-2-w-custom"
BR2_LINUX_KERNEL_CUSTOM_DTS_DIR="$(BR2_EXTERNAL_RPI_PATH)/board/raspberrypi/zero2w_64/dts"
BR2_LINUX_KERNEL_NEEDS_HOST_OPENSSL=y
BR2_PACKAGE_FFMPEG_GPL=y
BR2_PACKAGE_FFMPEG_NONFREE=y
BR2_PACKAGE_FFMPEG_FFPROBE=y
BR2_PACKAGE_BZIP2=y
BR2_PACKAGE_GZIP=y
BR2_PACKAGE_PIGZ=y
BR2_PACKAGE_PIXZ=y
BR2_PACKAGE_ZSTD=y
BR2_PACKAGE_GDB=y
BR2_PACKAGE_GDB_SERVER=y
BR2_PACKAGE_GDB_DEBUGGER=y
BR2_PACKAGE_GDB_TUI=y
BR2_PACKAGE_HYPERFINE=y
BR2_PACKAGE_STRESS_NG=y
BR2_PACKAGE_BINUTILS=y
BR2_PACKAGE_BINUTILS_TARGET=y
BR2_PACKAGE_FD=y
BR2_PACKAGE_FINDUTILS=y
BR2_PACKAGE_GIT=y
BR2_PACKAGE_GREP=y
BR2_PACKAGE_JQ=y
BR2_PACKAGE_RIPGREP=y
BR2_PACKAGE_SED=y
BR2_PACKAGE_TREE=y
BR2_PACKAGE_DOSFSTOOLS=y
BR2_PACKAGE_EXFATPROGS=y
BR2_PACKAGE_F2FS_TOOLS=y
BR2_PACKAGE_CHOCOLATE_DOOM=y
BR2_PACKAGE_DOOM_WAD=y
BR2_PACKAGE_CAGE=y
BR2_PACKAGE_GLMARK2=y
BR2_PACKAGE_KMSCUBE=y
BR2_PACKAGE_MESA3D_DEMOS=y
BR2_PACKAGE_MESA3D=y
BR2_PACKAGE_MESA3D_GALLIUM_DRIVER_V3D=y
BR2_PACKAGE_MESA3D_OPENGL_ES=y
BR2_PACKAGE_SDL2_KMSDRM=y
BR2_PACKAGE_SDL2_WAYLAND=y
BR2_PACKAGE_SDL2_OPENGLES=y
BR2_PACKAGE_SDL2_MIXER=y
BR2_PACKAGE_SDL2_NET=y
BR2_PACKAGE_WESTON=y
BR2_PACKAGE_WESTON_VNC=y
# BR2_PACKAGE_WESTON_SHELL_IVI is not set
# BR2_PACKAGE_WESTON_SCREENSHARE is not set
BR2_PACKAGE_LINUX_FIRMWARE=y
BR2_PACKAGE_LINUX_FIRMWARE_RTL_815X=y
BR2_PACKAGE_RPI_FIRMWARE=y
BR2_PACKAGE_RPI_FIRMWARE_BOOTCODE_BIN=y
BR2_PACKAGE_RPI_FIRMWARE_VARIANT_PI_X=y
BR2_PACKAGE_RPI_FIRMWARE_CONFIG_FILE="$(BR2_EXTERNAL_RPI_PATH)/board/raspberrypi/zero2w_64/config.txt"
BR2_PACKAGE_RPI_FIRMWARE_CMDLINE_FILE=""
BR2_PACKAGE_DBUS_BROKER=y
BR2_PACKAGE_EVTEST=y
BR2_PACKAGE_GPTFDISK=y
BR2_PACKAGE_GPTFDISK_GDISK=y
BR2_PACKAGE_GPTFDISK_SGDISK=y
BR2_PACKAGE_I2C_TOOLS=y
BR2_PACKAGE_LM_SENSORS=y
BR2_PACKAGE_LSHW=y
BR2_PACKAGE_PICOCOM=y
BR2_PACKAGE_SPI_TOOLS=y
BR2_PACKAGE_PYTHON3=y
BR2_PACKAGE_PYTHON3_PY_PYC=y
BR2_PACKAGE_LIBARCHIVE_BSDTAR=y
BR2_PACKAGE_LIBARCHIVE_BSDCAT=y
BR2_PACKAGE_LZ4=y
BR2_PACKAGE_LZ4_PROGS=y
BR2_PACKAGE_ZLIB_NG=y
BR2_PACKAGE_CA_CERTIFICATES=y
BR2_PACKAGE_LIBSHA1=y
BR2_PACKAGE_MBEDTLS=y
BR2_PACKAGE_MBEDTLS_PROGRAMS=y
BR2_PACKAGE_LIBDRM_INSTALL_TESTS=y
BR2_PACKAGE_LIBEPOXY=y
BR2_PACKAGE_WAYLAND_UTILS=y
BR2_PACKAGE_DTC=y
BR2_PACKAGE_DTC_PROGRAMS=y
BR2_PACKAGE_LIBGPIOD2=y
BR2_PACKAGE_LIBGPIOD2_TOOLS=y
BR2_PACKAGE_LIBIIO=y
# BR2_PACKAGE_LIBIIO_XML_BACKEND is not set
# BR2_PACKAGE_LIBIIO_NETWORK_BACKEND is not set
# BR2_PACKAGE_LIBIIO_USB_BACKEND is not set
# BR2_PACKAGE_LIBIIO_SERIAL_BACKEND is not set
# BR2_PACKAGE_LIBIIO_IIOD is not set
BR2_PACKAGE_LIBIIO_TESTS=y
BR2_PACKAGE_LIBV4L=y
BR2_PACKAGE_LIBV4L_UTILS=y
BR2_PACKAGE_LIBCURL=y
BR2_PACKAGE_LIBCURL_CURL=y
BR2_PACKAGE_LIBCURL_WEBSOCKETS_SUPPORT=y
BR2_PACKAGE_LIBCURL_MBEDTLS=y
BR2_PACKAGE_DNSMASQ=y
# BR2_PACKAGE_DNSMASQ_TFTP is not set
BR2_PACKAGE_DROPBEAR=y
# BR2_PACKAGE_DROPBEAR_SMALL is not set
BR2_PACKAGE_IPROUTE2=y
BR2_PACKAGE_IPUTILS=y
# BR2_PACKAGE_IPUTILS_ARPING is not set
# BR2_PACKAGE_IPUTILS_CLOCKDIFF is not set
# BR2_PACKAGE_IPUTILS_TRACEPATH is not set
BR2_PACKAGE_NFTABLES=y
# BR2_PACKAGE_NFTABLES_PYTHON is not set
BR2_PACKAGE_NFTABLES_JSON=y
BR2_PACKAGE_RSYNC=y
BR2_PACKAGE_BASH_COMPLETION=y
BR2_PACKAGE_EZA=y
BR2_PACKAGE_FILE=y
BR2_PACKAGE_SUDO=y
BR2_PACKAGE_TMUX=y
BR2_PACKAGE_WHICH=y
BR2_PACKAGE_WLR_RANDR=y
BR2_PACKAGE_COREUTILS=y
BR2_PACKAGE_HTOP=y
BR2_PACKAGE_PROCPS_NG=y
BR2_PACKAGE_SEATD_BUILTIN=y
BR2_PACKAGE_SHADOW=y
BR2_PACKAGE_SHADOW_ACCOUNT_TOOLS_SETUID=y
BR2_PACKAGE_SYSTEMD_ANALYZE=y
BR2_PACKAGE_SYSTEMD_EFI=y
BR2_PACKAGE_SYSTEMD_COREDUMP=y
# BR2_PACKAGE_SYSTEMD_PSTORE is not set
BR2_PACKAGE_SYSTEMD_LOCALED=y
BR2_PACKAGE_SYSTEMD_LOGIND=y
BR2_PACKAGE_SYSTEMD_POLKIT=y
BR2_PACKAGE_SYSTEMD_REPART=y
BR2_PACKAGE_SYSTEMD_VCONSOLE_DEFAULT_KEYMAP="pl"
BR2_PACKAGE_TAR=y
BR2_PACKAGE_UTIL_LINUX_BINARIES=y
BR2_PACKAGE_UTIL_LINUX_IRQTOP=y
BR2_PACKAGE_UTIL_LINUX_KILL=y
BR2_PACKAGE_UTIL_LINUX_LOGGER=y
BR2_PACKAGE_UTIL_LINUX_LOSETUP=y
BR2_PACKAGE_UTIL_LINUX_WAITPID=y
BR2_PACKAGE_UTIL_LINUX_WIPEFS=y
BR2_PACKAGE_UTIL_LINUX_ZRAMCTL=y
BR2_PACKAGE_BAT=y
BR2_PACKAGE_VIM=y
BR2_TARGET_ROOTFS_F2FS=y
BR2_TARGET_ROOTFS_F2FS_LABEL="root"
BR2_TARGET_ROOTFS_F2FS_SIZE="500M"
# BR2_TARGET_ROOTFS_TAR is not set
BR2_TARGET_UBOOT=y
BR2_TARGET_UBOOT_BUILD_SYSTEM_KCONFIG=y
BR2_TARGET_UBOOT_CUSTOM_VERSION=y
BR2_TARGET_UBOOT_CUSTOM_VERSION_VALUE="2025.10-rc4"
BR2_TARGET_UBOOT_USE_CUSTOM_CONFIG=y
BR2_TARGET_UBOOT_CUSTOM_CONFIG_FILE="$(BR2_EXTERNAL_RPI_PATH)/board/raspberrypi/zero2w_64/uboot_defconfig"
BR2_TARGET_UBOOT_NEEDS_DTC=y
BR2_TARGET_UBOOT_NEEDS_PYELFTOOLS=y
BR2_PACKAGE_HOST_DOSFSTOOLS=y
BR2_PACKAGE_HOST_GENIMAGE=y
BR2_PACKAGE_HOST_KMOD_ZSTD=y
BR2_PACKAGE_HOST_MTOOLS=y
BR2_PACKAGE_CADDY=y
BR2_PACKAGE_COPYPARTY=y
BR2_PACKAGE_COPYPARTY_TFTP=y
BR2_PACKAGE_COPYPARTY_SQLITE=y
BR2_PACKAGE_COPYPARTY_ARGON2=y
BR2_PACKAGE_COPYPARTY_PILLOW=y
BR2_PACKAGE_COPYPARTY_FFMPEG=y
BR2_PACKAGE_COPYPARTY_FFPROBE=y
BR2_PACKAGE_WAYVNC=y
```

## fs/uki/Config.in
```kconfig
config BR2_TARGET_ROOTFS_UKI
	bool "initial RAM filesystem linked into unified kernel image"
	depends on BR2_HOST_GCC_AT_LEAST_8
	depends on BR2_PACKAGE_SYSTEMD_STUB_ARCH_SUPPORTS
	depends on BR2_PACKAGE_GNU_EFI_ARCH_SUPPORTS
	depends on BR2_LINUX_KERNEL
	select BR2_PACKAGE_HOST_IMAGEMAGICK if BR2_TARGET_ROOTFS_UKI_SPLASH_IMAGE != ""
	select BR2_PACKAGE_HOST_PYTHON3
	select BR2_PACKAGE_SYSTEMD_STUB
	select BR2_TARGET_ROOTFS_CPIO
	help
	  A unified kernel image (UKI) is a single executable which can be
	  booted directly from UEFI firmware, or automatically sourced by
	  boot-loaders with little or no configuration.

comment "UKI needs a Linux kernel to be built"
	depends on !BR2_LINUX_KERNEL

if BR2_TARGET_ROOTFS_UKI

config BR2_TARGET_ROOTFS_UKI_CMDLINE_FILE
	string "Kernel cmdline file"
	help
	  Path to a file containing kernel command line arguments

config BR2_TARGET_ROOTFS_UKI_CMDLINE
	string "Additional kernel cmdline arguments"
	help
	  Additional kernel cmdline arguments, which will be appended to
	  cmdline file

config BR2_TARGET_ROOTFS_UKI_SPLASH_IMAGE
	string "Splash image path"
	help
	  Path to splash image to be embedded in the UKI

config BR2_TARGET_ROOTFS_UKI_DEVICETREE
	bool
	default y if BR2_LINUX_KERNEL_DTS_SUPPORT

config BR2_TARGET_ROOTFS_UKI_NEED_ZBOOT
	bool
	default y if (BR2_aarch64 || BR2_riscv)

endif # BR2_TARGET_ROOTFS_UKI
```

## package/amd-ucode/Config.in
```kconfig
config BR2_PACKAGE_AMD_UCODE
	bool "amd-ucode"
	depends on BR2_x86_64 || BR2_i386
	help
	  This package provides AMD microcode data in initramfs format.

	  https://git.kernel.org/?p=linux/kernel/git/firmware/linux-firmware.git
```

## package/bottom/Config.in
```kconfig
config BR2_PACKAGE_BOTTOM
    bool "bottom"
    depends on BR2_PACKAGE_HOST_RUSTC_TARGET_ARCH_SUPPORTS
    select BR2_PACKAGE_HOST_RUSTC
    help
      Yet another cross-platform graphical process/system monitor

      https://github.com/ClementTsang/bottom
```

## package/caddy/Config.in
```kconfig
config BR2_PACKAGE_CADDY
	bool "caddy"
	depends on BR2_PACKAGE_HOST_GO_TARGET_ARCH_SUPPORTS
	help
	  Fast and extensible multi-platform HTTP/1-2-3 web server with
	  automatic HTTPS

	  https://github.com/caddyserver/caddy
```

## package/intel-ucode/Config.in
```kconfig
config BR2_PACKAGE_INTEL_UCODE
	bool "intel-ucode"
	depends on BR2_x86_64 || BR2_i386
	help
	  This package provides Intel microcode data in initramfs format.

	  https://github.com/intel/Intel-Linux-Processor-Microcode-Data-Files
```

## package/lab-module/Config.in
```kconfig
config BR2_PACKAGE_LAB_MODULE
	bool "lab module"
	depends on BR2_LINUX_KERNEL
	help
	  Drivers lab module

comment "Lab module needs a Linux kernel to be built"
	depends on !BR2_LINUX_KERNEL
```

## package/luakit/Config.in
```kconfig
config BR2_PACKAGE_LUAKIT
	bool "luakit"
	depends on BR2_PACKAGE_HAS_LUAINTERPRETER
	depends on BR2_PACKAGE_WEBKITGTK
	select BR2_PACKAGE_LUAFILESYSTEM
	select BR2_PACKAGE_SQLITE
	help
		Luakit is a fast, light and simple to use micro-browser framework
		extensible by Lua using the WebKit web content engine and the GTK+ toolkit.


comment "Luakit needs Lua 5.1 interpreter"
	depends on !BR2_PACKAGE_HAS_LUAINTERPRETER
	depends on BR2_PACKAGE_LUA && !BR2_PACKAGE_LUA_5_1

comment "Luakit needs WebkitGTK"
	depends on !BR2_PACKAGE_WEBKITGTK
```

## package/python-copyparty/Config.in
```kconfig
config BR2_PACKAGE_PYTHON_COPYPARTY
	bool "python-copyparty"
	depends on BR2_PACKAGE_PYTHON3
	select BR2_PACKAGE_PYTHON3_SSL # runtime
	select BR2_PACKAGE_PYTHON3_PYEXPAT # runtime
	select BR2_PACKAGE_PYTHON3_ZLIB # runtime
	select BR2_PACKAGE_PYTHON_JINJA2 # runtime
	help
	  Portable file server with accelerated resumable uploads, dedup,
	  WebDAV, FTP, TFTP, zeroconf, media indexer, thumbnails++
	  all in one file, no deps

	  https://github.com/9001/copyparty

if BR2_PACKAGE_PYTHON_COPYPARTY

	config BR2_PACKAGE_PYTHON_COPYPARTY_TFTP
	bool "TFTP support"
	select BR2_PACKAGE_PYTHON_PARTFTPY

	config BR2_PACKAGE_PYTHON_COPYPARTY_SQLITE
	bool "SQLite support"
	select BR2_PACKAGE_PYTHON3_SQLITE

	config BR2_PACKAGE_PYTHON_COPYPARTY_ARGON2
	bool "Password hashing"
	select BR2_PACKAGE_PYTHON_ARGON2_CFFI

	config BR2_PACKAGE_PYTHON_COPYPARTY_PILLOW
	bool "Image thumbnails"
	select BR2_PACKAGE_PYTHON_PILLOW

	config BR2_PACKAGE_PYTHON_COPYPARTY_FFMPEG
	bool "Video transcode"
	select BR2_PACKAGE_FFMPEG
	select BR2_PACKAGE_FFMPEG_FFMPEG

	config BR2_PACKAGE_PYTHON_COPYPARTY_FFPROBE
	bool "Audio/media tags"
	select BR2_PACKAGE_FFMPEG
	select BR2_PACKAGE_FFMPEG_PROBE

endif #BR2_PACKAGE_PYTHON_COPYPARTY
```

## package/python-partftpy/Config.in
```kconfig
config BR2_PACKAGE_PYTHON_PARTFTPY
	bool "python-partftpy"
	depends on BR2_PACKAGE_PYTHON3
	help
	  Pure Python TFTP library (copyparty edition)

	  https://github.com/9001/partftpy
```

## package/systemd-stub/Config.in
```kconfig
config BR2_PACKAGE_SYSTEMD_STUB_ARCH_SUPPORTS
	bool
	default y if BR2_aarch64
	default y if BR2_arm
	default y if BR2_i386 || BR2_x86_64
	default y if BR2_riscv

config BR2_PACKAGE_SYSTEMD_STUB_EFI_ARCH
	string
	default "aa64"  if BR2_aarch64
	default "arm"   if BR2_arm
	default "ia32"  if BR2_i386
	default "x64"   if BR2_x86_64
	default "riscv" if BR2_riscv

config BR2_PACKAGE_SYSTEMD_STUB
	bool
	depends on BR2_PACKAGE_SYSTEMD_STUB_ARCH_SUPPORTS
	select BR2_PACKAGE_GNU_EFI
	select BR2_PACKAGE_LIBCAP
	select BR2_PACKAGE_LIBXCRYPT
	select BR2_PACKAGE_UTIL_LINUX
	select BR2_PACKAGE_UTIL_LINUX_LIBS
	select BR2_PACKAGE_UTIL_LINUX_MOUNT
```

## package/ukify/Config.in.host
```kconfig
config BR2_PACKAGE_HOST_UKIFY
	bool
	depends on BR2_HOST_GCC_AT_LEAST_8
	select BR2_PACKAGE_HOST_PYTHON3
```
