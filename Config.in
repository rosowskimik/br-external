## Config.in
```kconfig
menu "Target Packages"

source "$BR2_EXTERNAL_RPI_PATH/package/aml/Config.in"
source "$BR2_EXTERNAL_RPI_PATH/package/bottom/Config.in"
source "$BR2_EXTERNAL_RPI_PATH/package/caddy/Config.in"
source "$BR2_EXTERNAL_RPI_PATH/package/copyparty/Config.in"
source "$BR2_EXTERNAL_RPI_PATH/package/intel-ucode/Config.in"
source "$BR2_EXTERNAL_RPI_PATH/package/neatvnc/Config.in"
source "$BR2_EXTERNAL_RPI_PATH/package/python-partftpy/Config.in"
source "$BR2_EXTERNAL_RPI_PATH/package/systemd-stub/Config.in"
source "$BR2_EXTERNAL_RPI_PATH/package/wayvnc/Config.in"

endmenu

menu "Host Packages"

source "$BR2_EXTERNAL_RPI_PATH/package/ukify/Config.in.host"

endmenu

menu "Filesystem Images"

source "$BR2_EXTERNAL_RPI_PATH/fs/uki/Config.in"

endmenu
```
